/* USER CODE BEGIN Header */
/**
  ******************************************************************************
  * @file           : main.c
  * @brief          : Main program body
  ******************************************************************************
  * @attention

  ******************************************************************************
  */
/* USER CODE END Header */
/* Includes ------------------------------------------------------------------*/
#include "main.h"
#include "spi.h"
#include "tim.h"
#include "usart.h"
#include "gpio.h"

/* Private includes ----------------------------------------------------------*/
/* USER CODE BEGIN Includes */
#include <stdio.h>           
#include "string.h"           
#include "spi.h"              

/* USER CODE END Includes */

/* Private typedef -----------------------------------------------------------*/
/* USER CODE BEGIN PTD */


#define WAITREPEATTIME 10
      
uint8_t flg_sendtype=0;
    //1 -- FLASHTYPE_SEND_TXINFORM
    //2 -- FLASHTYPE_SEND_DATA
    //3 -- FLASHTYPE_SEND_LAST_DATA
    //4 -- FLASHTYPE_SEND_CRC 
    //10 -- FLASHTYPE_GET_SENSOR_DATA
    
uint8_t iflashstep=0;
    //1 -- FLASHSTATUS_SEND_TXINFORM
    //2 -- FLASHSTATUS_RECEIVE_TXINFORM_RESPONSE
    //3 -- FLASHSTATUS_SEND_DATA
    //4 -- FLASHSTATUS_RECEIVE_DATA_RESPONSE
    //5 -- FLASHSTATUS_SEND_CRC 
    //6 -- FLASHSTATUS_RECEIVE_CRC_RESPONSE
    
uint32_t iwaitrespcount=0;  
uint8_t flg_repeat=0;  
uint8_t islaveaddrout=0;
uint8_t islaveaddrin=0;


uint8_t mastercmd[TXDATALEN]={0};    


/* USER CODE END PTD */

/* Private define ------------------------------------------------------------*/
/* USER CODE BEGIN PD */

uint32_t iflashoff =0;
uint32_t irestlen =0;
uint8_t flg_lastpackage=0;

#define TOTAL_FLASHDATA_SIZE    (2048 )          //2k
uint32_t icrctempdata[TOTAL_FLASHDATA_SIZE/4+1]={0};
   
const uint8_t FLASHTEMPDATA[TOTAL_FLASHDATA_SIZE]=     
{ 
 0x00,0x01,0x02,0x03,0x04,0x05,0x06,0x07,0x08,0x09,0x0A,0x0B,0x0C,0x0D,0x0E,0x0F,0x10,0x11,0x12,0x13,0x14,0x15,0x16,0x17,0x18,0x19,0x1A,0x1B,0x1C,0x1D,0x1E,0x1F, 
 0x20,0x21,0x22,0x23,0x24,0x25,0x26,0x27,0x28,0x29,0x2A,0x2B,0x2C,0x2D,0x2E,0x2F,0x30,0x31,0x32,0x33,0x34,0x35,0x36,0x37,0x38,0x39,0x3A,0x3B,0x3C,0x3D,0x3E,0x3F, 
 0x40,0x41,0x42,0x43,0x44,0x45,0x46,0x47,0x48,0x49,0x4A,0x4B,0x4C,0x4D,0x4E,0x4F,0x50,0x51,0x52,0x53,0x54,0x55,0x56,0x57,0x58,0x59,0x5A,0x5B,0x5C,0x5D,0x5E,0x5F, 
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 0xE0,0xE1,0xE2,0xE3,0xE4,0xE5,0xE6,0xE7,0xE8,0xE9,0xEA,0xEB,0xEC,0xED,0xEE,0xEF,0xF0,0xF1,0xF2,0xF3,0xF4,0xF5,0xF6,0xF7,0xF8,0xF9,0xFA,0xFB,0xFC,0xFD,0xFE,0xFF
 , //1
 0x00,0x01,0x02,0x03,0x04,0x05,0x06,0x07,0x08,0x09,0x0A,0x0B,0x0C,0x0D,0x0E,0x0F,0x10,0x11,0x12,0x13,0x14,0x15,0x16,0x17,0x18,0x19,0x1A,0x1B,0x1C,0x1D,0x1E,0x1F, 
 0x20,0x21,0x22,0x23,0x24,0x25,0x26,0x27,0x28,0x29,0x2A,0x2B,0x2C,0x2D,0x2E,0x2F,0x30,0x31,0x32,0x33,0x34,0x35,0x36,0x37,0x38,0x39,0x3A,0x3B,0x3C,0x3D,0x3E,0x3F, 
 0x40,0x41,0x42,0x43,0x44,0x45,0x46,0x47,0x48,0x49,0x4A,0x4B,0x4C,0x4D,0x4E,0x4F,0x50,0x51,0x52,0x53,0x54,0x55,0x56,0x57,0x58,0x59,0x5A,0x5B,0x5C,0x5D,0x5E,0x5F, 
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 0xE0,0xE1,0xE2,0xE3,0xE4,0xE5,0xE6,0xE7,0xE8,0xE9,0xEA,0xEB,0xEC,0xED,0xEE,0xEF,0xF0,0xF1,0xF2,0xF3,0xF4,0xF5,0xF6,0xF7,0xF8,0xF9,0xFA,0xFB,0xFC,0xFD,0xFE,0xFF
 , //2
 0x00,0x01,0x02,0x03,0x04,0x05,0x06,0x07,0x08,0x09,0x0A,0x0B,0x0C,0x0D,0x0E,0x0F,0x10,0x11,0x12,0x13,0x14,0x15,0x16,0x17,0x18,0x19,0x1A,0x1B,0x1C,0x1D,0x1E,0x1F, 
 0x20,0x21,0x22,0x23,0x24,0x25,0x26,0x27,0x28,0x29,0x2A,0x2B,0x2C,0x2D,0x2E,0x2F,0x30,0x31,0x32,0x33,0x34,0x35,0x36,0x37,0x38,0x39,0x3A,0x3B,0x3C,0x3D,0x3E,0x3F, 
 0x40,0x41,0x42,0x43,0x44,0x45,0x46,0x47,0x48,0x49,0x4A,0x4B,0x4C,0x4D,0x4E,0x4F,0x50,0x51,0x52,0x53,0x54,0x55,0x56,0x57,0x58,0x59,0x5A,0x5B,0x5C,0x5D,0x5E,0x5F, 
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 0xE0,0xE1,0xE2,0xE3,0xE4,0xE5,0xE6,0xE7,0xE8,0xE9,0xEA,0xEB,0xEC,0xED,0xEE,0xEF,0xF0,0xF1,0xF2,0xF3,0xF4,0xF5,0xF6,0xF7,0xF8,0xF9,0xFA,0xFB,0xFC,0xFD,0xFE,0xFF
 , //3
 0x00,0x01,0x02,0x03,0x04,0x05,0x06,0x07,0x08,0x09,0x0A,0x0B,0x0C,0x0D,0x0E,0x0F,0x10,0x11,0x12,0x13,0x14,0x15,0x16,0x17,0x18,0x19,0x1A,0x1B,0x1C,0x1D,0x1E,0x1F, 
 0x20,0x21,0x22,0x23,0x24,0x25,0x26,0x27,0x28,0x29,0x2A,0x2B,0x2C,0x2D,0x2E,0x2F,0x30,0x31,0x32,0x33,0x34,0x35,0x36,0x37,0x38,0x39,0x3A,0x3B,0x3C,0x3D,0x3E,0x3F, 
 0x40,0x41,0x42,0x43,0x44,0x45,0x46,0x47,0x48,0x49,0x4A,0x4B,0x4C,0x4D,0x4E,0x4F,0x50,0x51,0x52,0x53,0x54,0x55,0x56,0x57,0x58,0x59,0x5A,0x5B,0x5C,0x5D,0x5E,0x5F, 
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 0xE0,0xE1,0xE2,0xE3,0xE4,0xE5,0xE6,0xE7,0xE8,0xE9,0xEA,0xEB,0xEC,0xED,0xEE,0xEF,0xF0,0xF1,0xF2,0xF3,0xF4,0xF5,0xF6,0xF7,0xF8,0xF9,0xFA,0xFB,0xFC,0xFD,0xFE,0xFF
 , //4
 0x00,0x01,0x02,0x03,0x04,0x05,0x06,0x07,0x08,0x09,0x0A,0x0B,0x0C,0x0D,0x0E,0x0F,0x10,0x11,0x12,0x13,0x14,0x15,0x16,0x17,0x18,0x19,0x1A,0x1B,0x1C,0x1D,0x1E,0x1F, 
 0x20,0x21,0x22,0x23,0x24,0x25,0x26,0x27,0x28,0x29,0x2A,0x2B,0x2C,0x2D,0x2E,0x2F,0x30,0x31,0x32,0x33,0x34,0x35,0x36,0x37,0x38,0x39,0x3A,0x3B,0x3C,0x3D,0x3E,0x3F, 
 0x40,0x41,0x42,0x43,0x44,0x45,0x46,0x47,0x48,0x49,0x4A,0x4B,0x4C,0x4D,0x4E,0x4F,0x50,0x51,0x52,0x53,0x54,0x55,0x56,0x57,0x58,0x59,0x5A,0x5B,0x5C,0x5D,0x5E,0x5F, 
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 0xE0,0xE1,0xE2,0xE3,0xE4,0xE5,0xE6,0xE7,0xE8,0xE9,0xEA,0xEB,0xEC,0xED,0xEE,0xEF,0xF0,0xF1,0xF2,0xF3,0xF4,0xF5,0xF6,0xF7,0xF8,0xF9,0xFA,0xFB,0xFC,0xFD,0xFE,0xFF
 , //5
 0x00,0x01,0x02,0x03,0x04,0x05,0x06,0x07,0x08,0x09,0x0A,0x0B,0x0C,0x0D,0x0E,0x0F,0x10,0x11,0x12,0x13,0x14,0x15,0x16,0x17,0x18,0x19,0x1A,0x1B,0x1C,0x1D,0x1E,0x1F, 
 0x20,0x21,0x22,0x23,0x24,0x25,0x26,0x27,0x28,0x29,0x2A,0x2B,0x2C,0x2D,0x2E,0x2F,0x30,0x31,0x32,0x33,0x34,0x35,0x36,0x37,0x38,0x39,0x3A,0x3B,0x3C,0x3D,0x3E,0x3F, 
 0x40,0x41,0x42,0x43,0x44,0x45,0x46,0x47,0x48,0x49,0x4A,0x4B,0x4C,0x4D,0x4E,0x4F,0x50,0x51,0x52,0x53,0x54,0x55,0x56,0x57,0x58,0x59,0x5A,0x5B,0x5C,0x5D,0x5E,0x5F, 
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 0xE0,0xE1,0xE2,0xE3,0xE4,0xE5,0xE6,0xE7,0xE8,0xE9,0xEA,0xEB,0xEC,0xED,0xEE,0xEF,0xF0,0xF1,0xF2,0xF3,0xF4,0xF5,0xF6,0xF7,0xF8,0xF9,0xFA,0xFB,0xFC,0xFD,0xFE,0xFF
 , //6
 0x00,0x01,0x02,0x03,0x04,0x05,0x06,0x07,0x08,0x09,0x0A,0x0B,0x0C,0x0D,0x0E,0x0F,0x10,0x11,0x12,0x13,0x14,0x15,0x16,0x17,0x18,0x19,0x1A,0x1B,0x1C,0x1D,0x1E,0x1F, 
 0x20,0x21,0x22,0x23,0x24,0x25,0x26,0x27,0x28,0x29,0x2A,0x2B,0x2C,0x2D,0x2E,0x2F,0x30,0x31,0x32,0x33,0x34,0x35,0x36,0x37,0x38,0x39,0x3A,0x3B,0x3C,0x3D,0x3E,0x3F, 
 0x40,0x41,0x42,0x43,0x44,0x45,0x46,0x47,0x48,0x49,0x4A,0x4B,0x4C,0x4D,0x4E,0x4F,0x50,0x51,0x52,0x53,0x54,0x55,0x56,0x57,0x58,0x59,0x5A,0x5B,0x5C,0x5D,0x5E,0x5F, 
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 0xE0,0xE1,0xE2,0xE3,0xE4,0xE5,0xE6,0xE7,0xE8,0xE9,0xEA,0xEB,0xEC,0xED,0xEE,0xEF,0xF0,0xF1,0xF2,0xF3,0xF4,0xF5,0xF6,0xF7,0xF8,0xF9,0xFA,0xFB,0xFC,0xFD,0xFE,0xFF
 , //7
 0x00,0x01,0x02,0x03,0x04,0x05,0x06,0x07,0x08,0x09,0x0A,0x0B,0x0C,0x0D,0x0E,0x0F,0x10,0x11,0x12,0x13,0x14,0x15,0x16,0x17,0x18,0x19,0x1A,0x1B,0x1C,0x1D,0x1E,0x1F, 
 0x20,0x21,0x22,0x23,0x24,0x25,0x26,0x27,0x28,0x29,0x2A,0x2B,0x2C,0x2D,0x2E,0x2F,0x30,0x31,0x32,0x33,0x34,0x35,0x36,0x37,0x38,0x39,0x3A,0x3B,0x3C,0x3D,0x3E,0x3F, 
 0x40,0x41,0x42,0x43,0x44,0x45,0x46,0x47,0x48,0x49,0x4A,0x4B,0x4C,0x4D,0x4E,0x4F,0x50,0x51,0x52,0x53,0x54,0x55,0x56,0x57,0x58,0x59,0x5A,0x5B,0x5C,0x5D,0x5E,0x5F, 
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 0xE0,0xE1,0xE2,0xE3,0xE4,0xE5,0xE6,0xE7,0xE8,0xE9,0xEA,0xEB,0xEC,0xED,0xEE,0xEF,0xF0,0xF1,0xF2,0xF3,0xF4,0xF5,0xF6,0xF7,0xF8,0xF9,0xFA,0xFB,0xFC,0xFD,0xFE,0xFF
//8
};

  
/* USER CODE END PD */

/* Private macro -------------------------------------------------------------*/
/* USER CODE BEGIN PM */


/* USER CODE END PM */

/* Private variables ---------------------------------------------------------*/

/* USER CODE BEGIN PV */

/* USER CODE END PV */

/* Private function prototypes -----------------------------------------------*/
void SystemClock_Config(void);
/* USER CODE BEGIN PFP */

/* USER CODE END PFP */

/* Private user code ---------------------------------------------------------*/
/* USER CODE BEGIN 0 */

void delay_nop(uint32_t nCount) 
{ 
   for(; nCount != 0; nCount--)  
   { 
      __NOP(); 
   } 
}

void iputs1(char *msg)
{
   while(*msg)
   Send_Data_To_UART1(*msg++);   
}


void iputbytes1(uint8_t *msg, uint32_t ilen)
{
   while(ilen--)
   Send_Data_To_UART1(*msg++);
}

void Send_Data_To_UART1 (uint8_t c)
{
   USART1->TDR = c;
   while( (USART1-> ISR & (1<<7) ) ==0 );
}


uint8_t get_checksum_8(uint8_t *ival, uint32_t inum)
{
   uint32_t i =0;
   uint8_t iret =0;
   uint16_t isum =0;

   for (i=0; i<inum; i++)
   {
      isum += ival[i]; 
   }

   iret = (uint8_t)(isum & 0xff);

   return iret;
}

 
void uartsendcmd(uint8_t *scmd, uint32_t ilen)
{
   //switch to tx 
   delay_nop(WAIT2TE_MASTER);  
   switch2send(USART1); 

   //iputbytes1((uint8_t *)scmd,ilen);     
   iputbytes1(scmd,ilen);     

   //switch to rx
   delay_nop(WAIT2RE0_MASTER);    
   switch2read(USART1);   
}   

uint32_t byte2uint32(uint8_t *strin, uint32_t *strout, uint32_t ilen)
{

   uint32_t i = 0;
   uint32_t iret = 0;

   //get crc adder
   for ( i=0; i<(ilen/4); i++)
   {
      strout[i] = (uint32_t)((strin[4*i] << 24) | (strin[4*i+1] << 16) | (strin[4*i+ 2] << 8) | strin[4*i+3]);
   }

   //last word
   if ( (ilen%4) == 3)
      strout[i] = (uint32_t)((strin[4*i] << 24) | (strin[4*i+1] << 16) | (strin[4*i+ 2] << 8) );
   if ( (ilen%4) == 2) 
      strout[i] = (uint32_t)((strin[4*i] << 24) | (strin[4*i+1] << 16) );
   if ( (ilen%4) == 1)
      strout[i] = (uint32_t)((strin[4*i] << 24) );
   
   
   //get crc len
   if( (ilen%4) ==0)
      iret =  ilen/4;
   else
      iret = ilen/4 +1;
   
   return iret;
}


uint32_t calcu_crc32(uint32_t *idatain, uint32_t len)
{
   uint32_t icrc_poly = 0x04C11DB7;  
   uint32_t icrc_out = 0xffffffff;  

   for(uint32_t i = 0; i < len; i++)
   {
      icrc_out ^= idatain[i];        
      
      //Send_Data_To_UART1(i);  //test

      for (uint8_t j = 0; j < 32; j++)
      {
         if (icrc_out & 0x80000000)
            icrc_out = (icrc_out << 1) ^ icrc_poly;
         else
            icrc_out <<= 1;
      }
   }
   
   return (icrc_out);
}

uint32_t calcu_crc32ex(uint32_t *idatain, uint32_t len, uint32_t icrc_in)
{
   uint32_t icrc_poly = 0x04C11DB7;  
   uint32_t icrc_out = icrc_in;  

   for(uint32_t i = 0; i < len; i++)
   {
      icrc_out ^= idatain[i];        
      
      //Send_Data_To_UART1(i);  //test

      for (uint8_t j = 0; j < 32; j++)
      {
         if (icrc_out & 0x80000000)
            icrc_out = (icrc_out << 1) ^ icrc_poly;
         else
            icrc_out <<= 1;
      }
   }
   
   return (icrc_out);
}


void dowithuart(void)
{         
   //switch to tx
   delay_nop(WAIT2TE_MASTER);     //300  10  
   switch2send(USART1);   
         
   //iputs1("rx...\r\n");
   
   switch (irxdata2[3])   //command
   {
      case 0xD1:
      
            flg_sendtype=2;
            irestlen=TOTAL_FLASHDATA_SIZE;
            iflashoff=0;
            
            break;
   
      case 0xD2:   
         
            if(flg_lastpackage==0)
               flg_sendtype=2;
            else
               flg_sendtype=3;
            
            break;

      case 0xD3:
         
//--test      
LL_mDelay(6000);      

      
            if(islaveaddrout==1)
            {
               islaveaddrout=2;      //switch to slave2
               
               flg_sendtype=1;
               iwaitrespcount=0; 
               iflashstep=0;     
               flg_repeat=0;                
               flg_lastpackage=0;               
            }
      
            break;

      case 0xE3:
         
               flg_sendtype=1;
               iwaitrespcount=0; 
               iflashstep=0;     
               flg_repeat=0;  
               flg_lastpackage=0;

//--test      
LL_mDelay(6000);      
//uartsendcmd( (uint8_t*)"!!!!!!!!!!",10);        
      
               break;
      
      case 0xB1:
               break;
      

      default:
            
               break;

   }
   
   //switch to rx
   delay_nop(WAIT2RE_MASTER);  //WAIT2RE_SLAVE   //same
   switch2read(USART1);  
}

void checkresendcmd(void)
{   
   //------------ loop checking to send C1 ------------- 
   
   if(iflashstep==1)   
   {
      if(iwaitrespcount>=WAITREPEATTIME)
      {
         iwaitrespcount=0;
         flg_repeat=1;
         flg_sendtype=1;            
      }         
   }
   
   if (flg_sendtype==1)       
   {        
      flg_sendtype=0;
      iflashstep=1;
      iwaitrespcount=0;

//      mastercmd[0]=CMDHEADER1;  //0x55;
//      mastercmd[1]=CMDHEADER2;  //0xAA;
//      mastercmd[2]=0x02;    
//      mastercmd[3]=0xC1;        //inform to send 2k flash data
//      mastercmd[4]=get_checksum_8(mastercmd,4);
//      uartsendcmd(mastercmd,5);
      
      mastercmd[0]=CMDHEADER1;  //0x55;
      mastercmd[1]=CMDHEADER2;  //0xAA;
      mastercmd[2]=0x03;    
      mastercmd[3]=0xC1;        //inform to send 2k flash data
      mastercmd[4]=islaveaddrout;
      mastercmd[5]=get_checksum_8(mastercmd,5);
      uartsendcmd(mastercmd,6);
      
      flg_repeat=0;         
   }
   
   
   //------------ loop checking to  send C2 ------------- 
   
   if(iflashstep==3)   
   {
      if(iwaitrespcount>=WAITREPEATTIME)
      {
         iwaitrespcount=0;
         flg_repeat=1;
         flg_sendtype=2;   
                     
      }         
   }      

   if (flg_sendtype==2)       
   {        
      flg_sendtype=0;
      iflashstep=3;
      iwaitrespcount=0;
      
      static uint32_t isendnum=0;

      if(flg_repeat==1)
      {
         iflashoff-=isendnum;
         irestlen+=isendnum;            
      }

      isendnum=PACKAGELEN;
      if(irestlen<=PACKAGELEN)
      {
         isendnum=irestlen;
         flg_lastpackage=1;
      }

////      mastercmd[0]=CMDHEADER1;  //0x55;
////      mastercmd[1]=CMDHEADER2;  //0xAA;
////      mastercmd[2]=isendnum+2;  //64+2  
////      mastercmd[3]=0xC2;      

////      for(uint8_t i=0; i<isendnum; i++)  //64         
////         mastercmd[4+i] = FLASHTEMPDATA[iflashoff+i];

////      mastercmd[isendnum+4]=get_checksum_8(mastercmd,isendnum+4); 
////      uartsendcmd(mastercmd,isendnum+5);   
      
//      mastercmd[0]=CMDHEADER1;  //0x55;
//      mastercmd[1]=CMDHEADER2;  //0xAA;
//      mastercmd[2]=0x03;    
//      mastercmd[3]=0xC2;        //inform to send 2k flash data
//      mastercmd[4]=islaveaddrout;
//      mastercmd[5]=get_checksum_8(mastercmd,5);
//      uartsendcmd(mastercmd,6);
      

      mastercmd[0]=CMDHEADER1;  //0x55;
      mastercmd[1]=CMDHEADER2;  //0xAA;
      mastercmd[2]=isendnum+3;  //len 
      mastercmd[3]=0xC2;      
      mastercmd[4]=islaveaddrout;      

      for(uint8_t i=0; i<isendnum; i++)  //64         
         mastercmd[5+i] = FLASHTEMPDATA[iflashoff+i];

      mastercmd[isendnum+5]=get_checksum_8(mastercmd,isendnum+5); 
      uartsendcmd(mastercmd,isendnum+6);   


      iflashoff+=isendnum;
      irestlen-=isendnum;

      flg_repeat=0;         
   }
   
   //------------ loop checking to send C3 ------------- 
   
   if(iflashstep==5)   
   {
      if(iwaitrespcount>=WAITREPEATTIME)
      {
         iwaitrespcount=0;
         flg_repeat=1;
         flg_sendtype=3;   
                     
      }         
   }        
   
   if (flg_sendtype==3)       
   {        
      flg_sendtype=0;
      iflashstep=5;
      iwaitrespcount=0;
      uint32_t icrc=0;
      uint32_t icrclen=0;
      
      //make crc 
      icrclen=byte2uint32( (uint8_t *)FLASHTEMPDATA,icrctempdata,iflashoff);   
      icrc = calcu_crc32(icrctempdata, icrclen);            

////      mastercmd[0]=CMDHEADER1;  //0x55;
////      mastercmd[1]=CMDHEADER2;  //0xAA;
////      mastercmd[2]=0x06;    
////      mastercmd[3]=0xC3;  

////      mastercmd[4]=icrc>>24;  
////      mastercmd[5]=icrc>>16;   
////      mastercmd[6]=icrc>>8;   
////      mastercmd[7]=icrc;  

////      mastercmd[8]=get_checksum_8(mastercmd,8); 
////      uartsendcmd(mastercmd,9);
      
      mastercmd[0]=CMDHEADER1;  //0x55;
      mastercmd[1]=CMDHEADER2;  //0xAA;
      mastercmd[2]=0x07;    
      mastercmd[3]=0xC3;  
      mastercmd[4]=islaveaddrout;  

      mastercmd[5]=icrc>>24;  
      mastercmd[6]=icrc>>16;   
      mastercmd[7]=icrc>>8;   
      mastercmd[8]=icrc;  

      mastercmd[9]=get_checksum_8(mastercmd,9); 
      uartsendcmd(mastercmd,10);
      
      
      
   }     
}      


/* USER CODE END 0 */

/**
  * @brief  The application entry point.
  * @retval int
  */
int main(void)
{
  /* USER CODE BEGIN 1 */
   uint8_t stest[20]={0};   

  /* USER CODE END 1 */

  /* MCU Configuration--------------------------------------------------------*/

  /* Reset of all peripherals, Initializes the Flash interface and the Systick. */
  LL_APB2_GRP1_EnableClock(LL_APB2_GRP1_PERIPH_SYSCFG);
  LL_APB1_GRP1_EnableClock(LL_APB1_GRP1_PERIPH_PWR);

  /* SysTick_IRQn interrupt configuration */
  NVIC_SetPriority(SysTick_IRQn, 3);

  LL_SYSCFG_EnablePinRemap(LL_SYSCFG_PIN_RMP_PA11);
  LL_SYSCFG_EnablePinRemap(LL_SYSCFG_PIN_RMP_PA12);

  /* USER CODE BEGIN Init */

  /* USER CODE END Init */

  /* Configure the system clock */
  SystemClock_Config();

  /* USER CODE BEGIN SysInit */


   /* USER CODE END SysInit */

   /* Initialize all configured peripherals */
   MX_GPIO_Init();
   MX_USART1_UART_Init();
   MX_TIM1_Init();
   MX_SPI1_Init();
   MX_TIM17_Init();
   
   /* USER CODE BEGIN 2 */
   
   LL_RCC_ConfigMCO(LL_RCC_MCO1SOURCE_SYSCLK, LL_RCC_MCO1_DIV_4);   //12Mhz = 48Mhz/4



   //switch to tx 
   //switch2send(USART1); 
   //iputs1("start...\r\n");   
   //iputs1(".."); 
   //LL_mDelay(1);  
   
   LL_mDelay(10);  //20
   uartsendcmd( (uint8_t*)"!!!",3);   //start
   
   
  /* USER CODE END 2 */

  /* Infinite loop */
  /* USER CODE BEGIN WHILE */
    
   islaveaddrout=1;
   flg_sendtype=1;
   

   while (1)
   { 
      static uint32_t iuart_txcount=0;
      static uint32_t iuart_txledcount=0;             
      uint8_t ichecksum=0;   
      

    /* USER CODE END WHILE */

    /* USER CODE BEGIN 3 */

      if(flg_timer1==1)
      {
         flg_timer1=0;
         
         iuart_txcount++;
         iuart_txledcount++;   
         
         if( (iflashstep==1) || (iflashstep==3) || (iflashstep==5) )
            iwaitrespcount++;
         
      } 

      //uart rx
      if (flg_rx==1)
      {
         flg_rx=0;  
         
         islaveaddrin=irxdata2[4];
         
         //checksum
         ichecksum = get_checksum_8((uint8_t *)irxdata2,irxcount2-1);
         
         if(ichecksum == irxdata2[irxcount2-1])   
         {            
            //refresh step          
            if( (iflashstep==1) || (iflashstep==3) || (iflashstep==5) )
            {
               iwaitrespcount=0; 
               iflashstep+=1;               
            }
         
            if(islaveaddrin==islaveaddrout)
               dowithuart(); 
         }

      }
      
      //checking to send flash data
      checkresendcmd();

      
      //checking to send A1 command (get sensor data)  
      
      if(iuart_txcount>=1) 
      {    
         iuart_txcount=0;  

         if (flg_sendtype ==10)       
         {       
            //flg_sendtype=0;
            
//            mastercmd[0]=CMDHEADER1;  //0x55;
//            mastercmd[1]=CMDHEADER2;  //0xAA;            
//            mastercmd[2]=0x02;        //len
//            mastercmd[3]=0xA1;        //get sensors data
//            mastercmd[4]=get_checksum_8(mastercmd,4); 
//            uartsendcmd(mastercmd,5);   
            
            mastercmd[0]=CMDHEADER1;  //0x55;
            mastercmd[1]=CMDHEADER2;  //0xAA;            
            mastercmd[2]=0x03;        //len
            mastercmd[3]=0xA1;        //get sensors data
            mastercmd[4]=islaveaddrout;  //addr
            mastercmd[5]=get_checksum_8(mastercmd,5); 
            uartsendcmd(mastercmd,6);               
         }
      }       
      
		if( iuart_txledcount >=1000)
		{	
			 iuart_txledcount=0;
			 LL_GPIO_TogglePin( LED_GPIO_Port, LED_Pin);
		}	 
 
  }  

  /* USER CODE END 3 */
}

/**
  * @brief System Clock Configuration
  * @retval None
  */
void SystemClock_Config(void)
{

  LL_FLASH_SetLatency(LL_FLASH_LATENCY_1);

  /* HSI configuration and activation */
  LL_RCC_HSI_Enable();
  while(LL_RCC_HSI_IsReady() != 1)
  {
  }

  LL_RCC_HSI_SetCalibTrimming(64);
  LL_RCC_SetHSIDiv(LL_RCC_HSI_DIV_1);
  /* Set AHB prescaler*/
  LL_RCC_SetAHBPrescaler(LL_RCC_HCLK_DIV_1);

  /* Sysclk activation on the HSI */
  LL_RCC_SetSysClkSource(LL_RCC_SYS_CLKSOURCE_HSI);
  while(LL_RCC_GetSysClkSource() != LL_RCC_SYS_CLKSOURCE_STATUS_HSI)
  {
  }

  /* Set APB1 prescaler*/
  LL_RCC_SetAPB1Prescaler(LL_RCC_APB1_DIV_1);
  LL_Init1msTick(48000000);
  /* Update CMSIS variable (which can be updated also through SystemCoreClockUpdate function) */
  LL_SetSystemCoreClock(48000000);
  LL_RCC_ConfigMCO(LL_RCC_MCO1SOURCE_SYSCLK, LL_RCC_MCO1_DIV_1);
}

/* USER CODE BEGIN 4 */

/* USER CODE END 4 */

/**
  * @brief  This function is executed in case of error occurrence.
  * @retval None
  */
void Error_Handler(void)
{
  /* USER CODE BEGIN Error_Handler_Debug */
   /* User can add his own implementation to report the HAL error return state */
   __disable_irq();
   while (1)
   {
   }
  /* USER CODE END Error_Handler_Debug */
}

#ifdef  USE_FULL_ASSERT
/**
  * @brief  Reports the name of the source file and the source line number
  *         where the assert_param error has occurred.
  * @param  file: pointer to the source file name
  * @param  line: assert_param error line source number
  * @retval None
  */
void assert_failed(uint8_t *file, uint32_t line)
{
  /* USER CODE BEGIN 6 */
   /* User can add his own implementation to report the file name and line number,
     ex: printf("Wrong parameters value: file %s on line %d\r\n", file, line) */
  /* USER CODE END 6 */
}
#endif /* USE_FULL_ASSERT */
